#include "first.dtsi"

&kscan {
	col-gpios = <&gpio0 9 GPIO_ACTIVE_HIGH> // PM 2
		, <&gpio0 16 GPIO_ACTIVE_HIGH> // PM 8
		, <&gpio0 17 GPIO_ACTIVE_HIGH> // PM 9
		, <&gpio0 20 GPIO_ACTIVE_HIGH> // PM 10
		, <&gpio0 22 GPIO_ACTIVE_HIGH> // PM 11
		, <&gpio0 11 GPIO_ACTIVE_HIGH> // PM 12
		;
};
